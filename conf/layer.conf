## conf/layer.conf
```bitbake
# We have a conf and classes directory, add to BBPATH
BBPATH .= ":${LAYERDIR}"

# We have recipes-* directories, add to BBFILES
BBFILES += "${LAYERDIR}/recipes-*/*/*.bb \
            ${LAYERDIR}/recipes-*/*/*.bbappend"

BBFILE_COLLECTIONS += "meta-jh"
BBFILE_PATTERN_meta-jh = "^${LAYERDIR}/"
BBFILE_PRIORITY_meta-jh = "6"

LAYERDEPENDS_meta-jh = "core"
LAYERSERIES_COMPAT_meta-jh = "gatesgarth"
```
